## conf/local.conf
```bitbake
# this following is for settings that are not checked into the build
# template -- see locallocal.conf.sample
include locallocal.conf

# CONF_VERSION is increased each time build/conf/ changes incompatibly
CONF_VERSION = "1"

# Which files do we want to parse:
BBMASK = ""

# Modify the following if you need to change the types of images generated
# most of the time, this is set by the machine conf or in a custom image
# recipe.
IMAGE_FSTYPES += "tar.gz"

# Make use of SMP:
#   PARALLEL_MAKE specifies how many concurrent compiler threads are spawned per bitbake process
#   BB_NUMBER_THREADS specifies how many concurrent bitbake tasks will be run

PREFERRED_PROVIDER_virtual/libgl = "mesa"
PREFERRED_PROVIDER_virtual/psplash = "psplash"
PREFERRED_PROVIDER_psplash-support = "psplash"
PREFERRED_PROVIDER_jpeg = "libjpeg-turbo"
PREFERRED_PROVIDER_jpeg-native = "libjpeg-turbo-native"

# Specify SGX GFX providers for Overo
PREFERRED_PROVIDER_virtual/egl_overo ?= "libgles-omap3"
PREFERRED_PROVIDER_virtual/libgles1_overo ?= "libgles-omap3"
PREFERRED_PROVIDER_virtual/libgles2_overo ?= "libgles-omap3"

PREFERRED_VERSION_libgles-omap3_overo = "5.01.01.02"
PREFERRED_VERSION_omap3-sgx-modules_overo = "5.01.01.02"

# SGX for Overo requires Kernel v3.5.7
PREFERRED_PROVIDER_virtual/kernel = "linux-gumstix"
PREFERRED_VERSION_linux-gumstix = "3.5.7"

PACKAGECONFIG_GL_pn-qtbase_overo = "gles2 linuxfb"

IMAGE_INSTALL_append_pn-gumstix-qt5-dev-image_overo = " \
 libdrm \
 qtbase-fonts \
 libgles-omap3 \
 libgles-omap3-rawdemos \
 omap3-sgx-modules \
 qt5-demo-extrafiles \
 qt5everywheredemo \
"

# Consider pam and opengl for SGX to work
DISTRO_FEATURES_append = " pam opengl"

# Use lxdm as graphical greeter
VIRTUAL-RUNTIME_graphical_init_manager = "lxdm"

# Don't generate the mirror tarball for SCM repos, the snapshot is enough
BB_GENERATE_MIRROR_TARBALLS = "0"

# By default disable interactive patch resolution (tasks will just fail instead):
PATCHRESOLVE = "noop"

DISTRO = "bec"

# the following is required because some BSP layers (fsl) don't set this, and then
# other BSP layers fail bitbake parsing (ti).
MACHINE_KERNEL_PR = "0"

MIRRORS_append = "\
    git://.*/.* http://sources.bec-systems.com/ \n \
    ftp://.*/.* http://sources.bec-systems.com/ \n \
    http://.*/.* http://sources.bec-systems.com/ \n \
    https://.*/.* http://sources.bec-systems.com/ \n"


# enable systemd

DISTRO_FEATURES_append = " systemd"
DISTRO_FEATURES_BACKFILL_CONSIDERED += "sysvinit"
VIRTUAL-RUNTIME_init_manager = "systemd"
VIRTUAL-RUNTIME_initscripts = "systemd-compat-units"

# Dont package kernel into image
RDEPENDS_kernel-base = ""

EXTRA_IMAGE_FEATURES = "debug-tweaks"
```
